## main/Kconfig.projbuild
```kconfig
menu "PaperRadio Configuration"

    config PAPERRADIO_HOSTNAME
        string "mDNS / DHCP hostname"
        default "paperradio"
        help
            Device is reachable as http://<hostname>.local on the LAN.

    config PAPERRADIO_AP_SSID
        string "Setup SoftAP SSID"
        default "PaperRadio-Setup"

    config PAPERRADIO_DISPLAY_ROTATE_180
        bool "Rotate e-paper UI by 180 degrees"
        default y
        help
            Flip the landscape (800x480) UI upside down depending on how the
            board is mounted.

    config PAPERRADIO_RING_BUFFER_KB
        int "Audio stream ring buffer size (KB, PSRAM)"
        range 64 2048
        default 384

    config PAPERRADIO_PREBUFFER_KB
        int "Pre-buffer before playback starts (KB)"
        range 8 512
        default 48

endmenu
```

## sdkconfig.defaults
```kconfig
CONFIG_IDF_TARGET="esp32s3"

# --- Flash (16MB) ---
CONFIG_ESPTOOLPY_FLASHSIZE_16MB=y
CONFIG_ESPTOOLPY_FLASHSIZE="16MB"
CONFIG_ESPTOOLPY_FLASHMODE_QIO=y
CONFIG_ESPTOOLPY_FLASHFREQ_80M=y

# --- Partition table ---
CONFIG_PARTITION_TABLE_CUSTOM=y
CONFIG_PARTITION_TABLE_CUSTOM_FILENAME="partitions.csv"

# --- CPU ---
CONFIG_ESP_DEFAULT_CPU_FREQ_MHZ_240=y

# --- PSRAM (8MB Octal) ---
CONFIG_SPIRAM=y
CONFIG_SPIRAM_MODE_OCT=y
CONFIG_SPIRAM_SPEED_80M=y
CONFIG_SPIRAM_BOOT_INIT=y
CONFIG_SPIRAM_USE_MALLOC=y
CONFIG_SPIRAM_MALLOC_ALWAYSINTERNAL=4096
CONFIG_SPIRAM_TRY_ALLOCATE_WIFI_LWIP=y
CONFIG_SPIRAM_ALLOW_STACK_EXTERNAL_MEMORY=n

# --- FreeRTOS ---
CONFIG_FREERTOS_HZ=1000

# --- Wi-Fi / LWIP: streaming throughput ---
CONFIG_ESP_WIFI_STATIC_RX_BUFFER_NUM=16
CONFIG_ESP_WIFI_DYNAMIC_RX_BUFFER_NUM=64
CONFIG_ESP_WIFI_DYNAMIC_TX_BUFFER_NUM=64
CONFIG_ESP_WIFI_RX_BA_WIN=32
CONFIG_LWIP_TCP_WND_DEFAULT=65535
CONFIG_LWIP_TCP_RECVMBOX_SIZE=64
CONFIG_LWIP_TCP_SND_BUF_DEFAULT=16384

# --- TLS (HTTPS streams) ---
CONFIG_MBEDTLS_EXTERNAL_MEM_ALLOC=y
CONFIG_MBEDTLS_DYNAMIC_BUFFER=y
CONFIG_MBEDTLS_CERTIFICATE_BUNDLE=y
CONFIG_MBEDTLS_CERTIFICATE_BUNDLE_DEFAULT_FULL=y

# --- HTTP client / server ---
CONFIG_HTTPD_MAX_REQ_HDR_LEN=2048
CONFIG_HTTPD_MAX_URI_LEN=1024
CONFIG_ESP_HTTP_CLIENT_ENABLE_HTTPS=y

# --- Logging ---
CONFIG_LOG_DEFAULT_LEVEL_INFO=y

# --- Compiler ---
CONFIG_COMPILER_OPTIMIZATION_PERF=y

# --- PaperRadio ---
CONFIG_PAPERRADIO_DISPLAY_ROTATE_180=y
```
